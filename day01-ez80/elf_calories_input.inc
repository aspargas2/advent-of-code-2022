; This is the input file from AoC with a simple find and replace applied because spasm has a length limit on a single .db derective '_>'
; I don't consdier this preprocessing of the input to be cheating because it only results in the input file, byte for byte, appearing in the final binary
	.db "3120\n"
	.db "4127\n"
	.db "1830\n"
	.db "1283\n"
	.db "5021\n"
	.db "3569\n"
	.db "3164\n"
	.db "2396\n"
	.db "4367\n"
	.db "2821\n"
	.db "6118\n"
	.db "4450\n"
	.db "1300\n"
	.db "3648\n"
	.db "1933\n"
	.db "\n"
	.db "4841\n"
	.db "6135\n"
	.db "5806\n"
	.db "8128\n"
	.db "4069\n"
	.db "6511\n"
	.db "3601\n"
	.db "4786\n"
	.db "\n"
	.db "2739\n"
	.db "2663\n"
	.db "2678\n"
	.db "1627\n"
	.db "7779\n"
	.db "7845\n"
	.db "9191\n"
	.db "9656\n"
	.db "\n"
	.db "1372\n"
	.db "11432\n"
	.db "14854\n"
	.db "15168\n"
	.db "3789\n"
	.db "\n"
	.db "47972\n"
	.db "\n"
	.db "5109\n"
	.db "4118\n"
	.db "3399\n"
	.db "6468\n"
	.db "6900\n"
	.db "4742\n"
	.db "4196\n"
	.db "6590\n"
	.db "7327\n"
	.db "6828\n"
	.db "2253\n"
	.db "7055\n"
	.db "\n"
	.db "1698\n"
	.db "5601\n"
	.db "1983\n"
	.db "6931\n"
	.db "6010\n"
	.db "4091\n"
	.db "6881\n"
	.db "2372\n"
	.db "6531\n"
	.db "4825\n"
	.db "3918\n"
	.db "\n"
	.db "8481\n"
	.db "8321\n"
	.db "1703\n"
	.db "7251\n"
	.db "2360\n"
	.db "10719\n"
	.db "5468\n"
	.db "6503\n"
	.db "\n"
	.db "12835\n"
	.db "11545\n"
	.db "3650\n"
	.db "11065\n"
	.db "\n"
	.db "6817\n"
	.db "6491\n"
	.db "4285\n"
	.db "4831\n"
	.db "2392\n"
	.db "8103\n"
	.db "8243\n"
	.db "8753\n"
	.db "3725\n"
	.db "1857\n"
	.db "\n"
	.db "1969\n"
	.db "4278\n"
	.db "4922\n"
	.db "2667\n"
	.db "2613\n"
	.db "4720\n"
	.db "4729\n"
	.db "5696\n"
	.db "3067\n"
	.db "2409\n"
	.db "2223\n"
	.db "5378\n"
	.db "3349\n"
	.db "3952\n"
	.db "\n"
	.db "4250\n"
	.db "2250\n"
	.db "5073\n"
	.db "5893\n"
	.db "3740\n"
	.db "2037\n"
	.db "4679\n"
	.db "1331\n"
	.db "3881\n"
	.db "5751\n"
	.db "3255\n"
	.db "3155\n"
	.db "4582\n"
	.db "1844\n"
	.db "3164\n"
	.db "\n"
	.db "5935\n"
	.db "4702\n"
	.db "1774\n"
	.db "2285\n"
	.db "4800\n"
	.db "3721\n"
	.db "5674\n"
	.db "3830\n"
	.db "1556\n"
	.db "4464\n"
	.db "2235\n"
	.db "1241\n"
	.db "1132\n"
	.db "6506\n"
	.db "\n"
	.db "6818\n"
	.db "2822\n"
	.db "6006\n"
	.db "5073\n"
	.db "2663\n"
	.db "4829\n"
	.db "5705\n"
	.db "2684\n"
	.db "2043\n"
	.db "7070\n"
	.db "3439\n"
	.db "2189\n"
	.db "\n"
	.db "3869\n"
	.db "4747\n"
	.db "2191\n"
	.db "6208\n"
	.db "3109\n"
	.db "3615\n"
	.db "8081\n"
	.db "3981\n"
	.db "7432\n"
	.db "1515\n"
	.db "3560\n"
	.db "\n"
	.db "3750\n"
	.db "4290\n"
	.db "5798\n"
	.db "5477\n"
	.db "2027\n"
	.db "1826\n"
	.db "6339\n"
	.db "6664\n"
	.db "2071\n"
	.db "5611\n"
	.db "4009\n"
	.db "2165\n"
	.db "\n"
	.db "4424\n"
	.db "3220\n"
	.db "3006\n"
	.db "5249\n"
	.db "1427\n"
	.db "4691\n"
	.db "2417\n"
	.db "1468\n"
	.db "2435\n"
	.db "2430\n"
	.db "4560\n"
	.db "1767\n"
	.db "1661\n"
	.db "5351\n"
	.db "3480\n"
	.db "\n"
	.db "9752\n"
	.db "11520\n"
	.db "7189\n"
	.db "11440\n"
	.db "7516\n"
	.db "\n"
	.db "6962\n"
	.db "6318\n"
	.db "6796\n"
	.db "7039\n"
	.db "6509\n"
	.db "3035\n"
	.db "4551\n"
	.db "6494\n"
	.db "4699\n"
	.db "6092\n"
	.db "7734\n"
	.db "\n"
	.db "5614\n"
	.db "7858\n"
	.db "1785\n"
	.db "5830\n"
	.db "2645\n"
	.db "4232\n"
	.db "7573\n"
	.db "6542\n"
	.db "4971\n"
	.db "5849\n"
	.db "\n"
	.db "5288\n"
	.db "2492\n"
	.db "4213\n"
	.db "3903\n"
	.db "6472\n"
	.db "3900\n"
	.db "3325\n"
	.db "5947\n"
	.db "4029\n"
	.db "2288\n"
	.db "3069\n"
	.db "3046\n"
	.db "2633\n"
	.db "5082\n"
	.db "\n"
	.db "1525\n"
	.db "9159\n"
	.db "10607\n"
	.db "13000\n"
	.db "4914\n"
	.db "\n"
	.db "2232\n"
	.db "4661\n"
	.db "3575\n"
	.db "3938\n"
	.db "5334\n"
	.db "3065\n"
	.db "1005\n"
	.db "2386\n"
	.db "3748\n"
	.db "2592\n"
	.db "2502\n"
	.db "4334\n"
	.db "\n"
	.db "20639\n"
	.db "30326\n"
	.db "\n"
	.db "7479\n"
	.db "6661\n"
	.db "2626\n"
	.db "7142\n"
	.db "4469\n"
	.db "6912\n"
	.db "1665\n"
	.db "7263\n"
	.db "3952\n"
	.db "7861\n"
	.db "2736\n"
	.db "\n"
	.db "2311\n"
	.db "6735\n"
	.db "3624\n"
	.db "5175\n"
	.db "6522\n"
	.db "1370\n"
	.db "2008\n"
	.db "3647\n"
	.db "6857\n"
	.db "3264\n"
	.db "2862\n"
	.db "4427\n"
	.db "6413\n"
	.db "\n"
	.db "2325\n"
	.db "7237\n"
	.db "\n"
	.db "1523\n"
	.db "2625\n"
	.db "1816\n"
	.db "1628\n"
	.db "8418\n"
	.db "5434\n"
	.db "6124\n"
	.db "3137\n"
	.db "2878\n"
	.db "4949\n"
	.db "\n"
	.db "2218\n"
	.db "5941\n"
	.db "3051\n"
	.db "4939\n"
	.db "7147\n"
	.db "5603\n"
	.db "5609\n"
	.db "1478\n"
	.db "5494\n"
	.db "7949\n"
	.db "\n"
	.db "3597\n"
	.db "1882\n"
	.db "2633\n"
	.db "2471\n"
	.db "6944\n"
	.db "3760\n"
	.db "3944\n"
	.db "2543\n"
	.db "6706\n"
	.db "6896\n"
	.db "6667\n"
	.db "1352\n"
	.db "2139\n"
	.db "\n"
	.db "4534\n"
	.db "7162\n"
	.db "6233\n"
	.db "3012\n"
	.db "4319\n"
	.db "4610\n"
	.db "2912\n"
	.db "4899\n"
	.db "5222\n"
	.db "5082\n"
	.db "3670\n"
	.db "6363\n"
	.db "\n"
	.db "12651\n"
	.db "\n"
	.db "9158\n"
	.db "34492\n"
	.db "\n"
	.db "15407\n"
	.db "9599\n"
	.db "18253\n"
	.db "12367\n"
	.db "\n"
	.db "3870\n"
	.db "12469\n"
	.db "20949\n"
	.db "\n"
	.db "5006\n"
	.db "12672\n"
	.db "2312\n"
	.db "5001\n"
	.db "1740\n"
	.db "12492\n"
	.db "\n"
	.db "6497\n"
	.db "5827\n"
	.db "5872\n"
	.db "3269\n"
	.db "5344\n"
	.db "2235\n"
	.db "6482\n"
	.db "1593\n"
	.db "2136\n"
	.db "5270\n"
	.db "1039\n"
	.db "6375\n"
	.db "\n"
	.db "8497\n"
	.db "3530\n"
	.db "7100\n"
	.db "6449\n"
	.db "9897\n"
	.db "9576\n"
	.db "\n"
	.db "5508\n"
	.db "1430\n"
	.db "8102\n"
	.db "3020\n"
	.db "4959\n"
	.db "6561\n"
	.db "3947\n"
	.db "3397\n"
	.db "8462\n"
	.db "1859\n"
	.db "\n"
	.db "9481\n"
	.db "11044\n"
	.db "\n"
	.db "1287\n"
	.db "12137\n"
	.db "6366\n"
	.db "1835\n"
	.db "10500\n"
	.db "6763\n"
	.db "\n"
	.db "2213\n"
	.db "4026\n"
	.db "3648\n"
	.db "7894\n"
	.db "7334\n"
	.db "1905\n"
	.db "1484\n"
	.db "2804\n"
	.db "4801\n"
	.db "3715\n"
	.db "\n"
	.db "3925\n"
	.db "10274\n"
	.db "6920\n"
	.db "1395\n"
	.db "5990\n"
	.db "2321\n"
	.db "7620\n"
	.db "1539\n"
	.db "\n"
	.db "2537\n"
	.db "6440\n"
	.db "1734\n"
	.db "1023\n"
	.db "1523\n"
	.db "1111\n"
	.db "2041\n"
	.db "5669\n"
	.db "6787\n"
	.db "7176\n"
	.db "7221\n"
	.db "2735\n"
	.db "\n"
	.db "1989\n"
	.db "1682\n"
	.db "3892\n"
	.db "3203\n"
	.db "3088\n"
	.db "4199\n"
	.db "2010\n"
	.db "2167\n"
	.db "2106\n"
	.db "3411\n"
	.db "2219\n"
	.db "3033\n"
	.db "4214\n"
	.db "2096\n"
	.db "3487\n"
	.db "\n"
	.db "5061\n"
	.db "1978\n"
	.db "1889\n"
	.db "4055\n"
	.db "2352\n"
	.db "4377\n"
	.db "3200\n"
	.db "3479\n"
	.db "1656\n"
	.db "4387\n"
	.db "3323\n"
	.db "1550\n"
	.db "3072\n"
	.db "5438\n"
	.db "4884\n"
	.db "\n"
	.db "1663\n"
	.db "1029\n"
	.db "2037\n"
	.db "5546\n"
	.db "4006\n"
	.db "6645\n"
	.db "6535\n"
	.db "1348\n"
	.db "5422\n"
	.db "2353\n"
	.db "6384\n"
	.db "1405\n"
	.db "\n"
	.db "5372\n"
	.db "4213\n"
	.db "1216\n"
	.db "4205\n"
	.db "3752\n"
	.db "5457\n"
	.db "4208\n"
	.db "3019\n"
	.db "5619\n"
	.db "4602\n"
	.db "3656\n"
	.db "3403\n"
	.db "5994\n"
	.db "\n"
	.db "2017\n"
	.db "15645\n"
	.db "11147\n"
	.db "\n"
	.db "10332\n"
	.db "9869\n"
	.db "6370\n"
	.db "13474\n"
	.db "2178\n"
	.db "7461\n"
	.db "\n"
	.db "18692\n"
	.db "10232\n"
	.db "4148\n"
	.db "2647\n"
	.db "\n"
	.db "66855\n"
	.db "\n"
	.db "4985\n"
	.db "9276\n"
	.db "9301\n"
	.db "4837\n"
	.db "8248\n"
	.db "8191\n"
	.db "3237\n"
	.db "4567\n"
	.db "2816\n"
	.db "\n"
	.db "55407\n"
	.db "\n"
	.db "6350\n"
	.db "5061\n"
	.db "3654\n"
	.db "4514\n"
	.db "6197\n"
	.db "3986\n"
	.db "3601\n"
	.db "4421\n"
	.db "6166\n"
	.db "3973\n"
	.db "2375\n"
	.db "1214\n"
	.db "5203\n"
	.db "5738\n"
	.db "\n"
	.db "21949\n"
	.db "20967\n"
	.db "\n"
	.db "3232\n"
	.db "6276\n"
	.db "3937\n"
	.db "5900\n"
	.db "2079\n"
	.db "6475\n"
	.db "2119\n"
	.db "5981\n"
	.db "2392\n"
	.db "2731\n"
	.db "2076\n"
	.db "4051\n"
	.db "2328\n"
	.db "\n"
	.db "3004\n"
	.db "3329\n"
	.db "1709\n"
	.db "4125\n"
	.db "4397\n"
	.db "1742\n"
	.db "5775\n"
	.db "3256\n"
	.db "2705\n"
	.db "1018\n"
	.db "1169\n"
	.db "2266\n"
	.db "3767\n"
	.db "4683\n"
	.db "6014\n"
	.db "\n"
	.db "2537\n"
	.db "2800\n"
	.db "1115\n"
	.db "3066\n"
	.db "2741\n"
	.db "4514\n"
	.db "3184\n"
	.db "2034\n"
	.db "5565\n"
	.db "2245\n"
	.db "5884\n"
	.db "3200\n"
	.db "5808\n"
	.db "4964\n"
	.db "1710\n"
	.db "\n"
	.db "5711\n"
	.db "2095\n"
	.db "4311\n"
	.db "3685\n"
	.db "3035\n"
	.db "1710\n"
	.db "4369\n"
	.db "2817\n"
	.db "5836\n"
	.db "3210\n"
	.db "1356\n"
	.db "4734\n"
	.db "\n"
	.db "10244\n"
	.db "9347\n"
	.db "8073\n"
	.db "8412\n"
	.db "9912\n"
	.db "8438\n"
	.db "9189\n"
	.db "4677\n"
	.db "\n"
	.db "4477\n"
	.db "5287\n"
	.db "6898\n"
	.db "7699\n"
	.db "4302\n"
	.db "6294\n"
	.db "7022\n"
	.db "8700\n"
	.db "6850\n"
	.db "8672\n"
	.db "\n"
	.db "7889\n"
	.db "6263\n"
	.db "8775\n"
	.db "5103\n"
	.db "6364\n"
	.db "6343\n"
	.db "2250\n"
	.db "5207\n"
	.db "3257\n"
	.db "3149\n"
	.db "\n"
	.db "17552\n"
	.db "10109\n"
	.db "7831\n"
	.db "4342\n"
	.db "\n"
	.db "1258\n"
	.db "11359\n"
	.db "12821\n"
	.db "3614\n"
	.db "\n"
	.db "6672\n"
	.db "3389\n"
	.db "10580\n"
	.db "11163\n"
	.db "11630\n"
	.db "2352\n"
	.db "11490\n"
	.db "\n"
	.db "6340\n"
	.db "\n"
	.db "5541\n"
	.db "7827\n"
	.db "4328\n"
	.db "2481\n"
	.db "2375\n"
	.db "8011\n"
	.db "4105\n"
	.db "2983\n"
	.db "2734\n"
	.db "2851\n"
	.db "1877\n"
	.db "\n"
	.db "22845\n"
	.db "27767\n"
	.db "\n"
	.db "32945\n"
	.db "\n"
	.db "7892\n"
	.db "13869\n"
	.db "8411\n"
	.db "12957\n"
	.db "1888\n"
	.db "2491\n"
	.db "\n"
	.db "6461\n"
	.db "4240\n"
	.db "6319\n"
	.db "4607\n"
	.db "1596\n"
	.db "7757\n"
	.db "3117\n"
	.db "1662\n"
	.db "2630\n"
	.db "2818\n"
	.db "5349\n"
	.db "\n"
	.db "3397\n"
	.db "2467\n"
	.db "2993\n"
	.db "5613\n"
	.db "1894\n"
	.db "5570\n"
	.db "4646\n"
	.db "2143\n"
	.db "5724\n"
	.db "6325\n"
	.db "6070\n"
	.db "5724\n"
	.db "2587\n"
	.db "2366\n"
	.db "\n"
	.db "2066\n"
	.db "6543\n"
	.db "10590\n"
	.db "\n"
	.db "9360\n"
	.db "7985\n"
	.db "7172\n"
	.db "9598\n"
	.db "9400\n"
	.db "6918\n"
	.db "9103\n"
	.db "\n"
	.db "5804\n"
	.db "2533\n"
	.db "4371\n"
	.db "2137\n"
	.db "4962\n"
	.db "4289\n"
	.db "3282\n"
	.db "4165\n"
	.db "5751\n"
	.db "1374\n"
	.db "2383\n"
	.db "2506\n"
	.db "5695\n"
	.db "3244\n"
	.db "\n"
	.db "7079\n"
	.db "6767\n"
	.db "3159\n"
	.db "1301\n"
	.db "10045\n"
	.db "10545\n"
	.db "5331\n"
	.db "2043\n"
	.db "\n"
	.db "4977\n"
	.db "4624\n"
	.db "5544\n"
	.db "3247\n"
	.db "1114\n"
	.db "1463\n"
	.db "4170\n"
	.db "2919\n"
	.db "2311\n"
	.db "5368\n"
	.db "3044\n"
	.db "1942\n"
	.db "1391\n"
	.db "\n"
	.db "2344\n"
	.db "2101\n"
	.db "4414\n"
	.db "4349\n"
	.db "4279\n"
	.db "3368\n"
	.db "3300\n"
	.db "5830\n"
	.db "1944\n"
	.db "3557\n"
	.db "6110\n"
	.db "3964\n"
	.db "2169\n"
	.db "\n"
	.db "4995\n"
	.db "5143\n"
	.db "9050\n"
	.db "5601\n"
	.db "3903\n"
	.db "3468\n"
	.db "4814\n"
	.db "3322\n"
	.db "8735\n"
	.db "\n"
	.db "3494\n"
	.db "1879\n"
	.db "3757\n"
	.db "3842\n"
	.db "1795\n"
	.db "1158\n"
	.db "7008\n"
	.db "6778\n"
	.db "7222\n"
	.db "6034\n"
	.db "6320\n"
	.db "\n"
	.db "6633\n"
	.db "7869\n"
	.db "3994\n"
	.db "7917\n"
	.db "9658\n"
	.db "9222\n"
	.db "5030\n"
	.db "2083\n"
	.db "5702\n"
	.db "\n"
	.db "2086\n"
	.db "3860\n"
	.db "1142\n"
	.db "5361\n"
	.db "3812\n"
	.db "2735\n"
	.db "2673\n"
	.db "2015\n"
	.db "1615\n"
	.db "4579\n"
	.db "5090\n"
	.db "5747\n"
	.db "1426\n"
	.db "2139\n"
	.db "4786\n"
	.db "\n"
	.db "3362\n"
	.db "6320\n"
	.db "2031\n"
	.db "7282\n"
	.db "5106\n"
	.db "3031\n"
	.db "1295\n"
	.db "6365\n"
	.db "3799\n"
	.db "3081\n"
	.db "6241\n"
	.db "1998\n"
	.db "\n"
	.db "8620\n"
	.db "5326\n"
	.db "8573\n"
	.db "5232\n"
	.db "8508\n"
	.db "5911\n"
	.db "7057\n"
	.db "1924\n"
	.db "2393\n"
	.db "8446\n"
	.db "\n"
	.db "3384\n"
	.db "5126\n"
	.db "3747\n"
	.db "5523\n"
	.db "2345\n"
	.db "3816\n"
	.db "3246\n"
	.db "5073\n"
	.db "5778\n"
	.db "1747\n"
	.db "5777\n"
	.db "5864\n"
	.db "5261\n"
	.db "5132\n"
	.db "3841\n"
	.db "\n"
	.db "11806\n"
	.db "11670\n"
	.db "13208\n"
	.db "8744\n"
	.db "5434\n"
	.db "4319\n"
	.db "\n"
	.db "10397\n"
	.db "4910\n"
	.db "16337\n"
	.db "16444\n"
	.db "6959\n"
	.db "\n"
	.db "18421\n"
	.db "7156\n"
	.db "7004\n"
	.db "2915\n"
	.db "\n"
	.db "6754\n"
	.db "5386\n"
	.db "6922\n"
	.db "7586\n"
	.db "7935\n"
	.db "2972\n"
	.db "6049\n"
	.db "7286\n"
	.db "3422\n"
	.db "2031\n"
	.db "6399\n"
	.db "\n"
	.db "7510\n"
	.db "6281\n"
	.db "5004\n"
	.db "2836\n"
	.db "4253\n"
	.db "2891\n"
	.db "2127\n"
	.db "\n"
	.db "4416\n"
	.db "1465\n"
	.db "1106\n"
	.db "6829\n"
	.db "4371\n"
	.db "2090\n"
	.db "4556\n"
	.db "2544\n"
	.db "3936\n"
	.db "6469\n"
	.db "1781\n"
	.db "\n"
	.db "6885\n"
	.db "1049\n"
	.db "8295\n"
	.db "9647\n"
	.db "3617\n"
	.db "4504\n"
	.db "3286\n"
	.db "9503\n"
	.db "\n"
	.db "17536\n"
	.db "2797\n"
	.db "4305\n"
	.db "9965\n"
	.db "\n"
	.db "34414\n"
	.db "28940\n"
	.db "\n"
	.db "25883\n"
	.db "25422\n"
	.db "5584\n"
	.db "\n"
	.db "18095\n"
	.db "18098\n"
	.db "16278\n"
	.db "\n"
	.db "3140\n"
	.db "3833\n"
	.db "3988\n"
	.db "6018\n"
	.db "4838\n"
	.db "3941\n"
	.db "4805\n"
	.db "5494\n"
	.db "2431\n"
	.db "5925\n"
	.db "2085\n"
	.db "5465\n"
	.db "4449\n"
	.db "1745\n"
	.db "1687\n"
	.db "\n"
	.db "1249\n"
	.db "9174\n"
	.db "11930\n"
	.db "5039\n"
	.db "4455\n"
	.db "10089\n"
	.db "5806\n"
	.db "\n"
	.db "7405\n"
	.db "1383\n"
	.db "5761\n"
	.db "6448\n"
	.db "7787\n"
	.db "1568\n"
	.db "4287\n"
	.db "3567\n"
	.db "5213\n"
	.db "1026\n"
	.db "4037\n"
	.db "\n"
	.db "15317\n"
	.db "19135\n"
	.db "2237\n"
	.db "\n"
	.db "1097\n"
	.db "9281\n"
	.db "3625\n"
	.db "10282\n"
	.db "2191\n"
	.db "7404\n"
	.db "5671\n"
	.db "9749\n"
	.db "\n"
	.db "5436\n"
	.db "5129\n"
	.db "1903\n"
	.db "2407\n"
	.db "3301\n"
	.db "3048\n"
	.db "4309\n"
	.db "1119\n"
	.db "3447\n"
	.db "6443\n"
	.db "3705\n"
	.db "2274\n"
	.db "5059\n"
	.db "4889\n"
	.db "\n"
	.db "5281\n"
	.db "8052\n"
	.db "5260\n"
	.db "3031\n"
	.db "4004\n"
	.db "5858\n"
	.db "5628\n"
	.db "1547\n"
	.db "3900\n"
	.db "4101\n"
	.db "6481\n"
	.db "\n"
	.db "21678\n"
	.db "7776\n"
	.db "\n"
	.db "3296\n"
	.db "3667\n"
	.db "2475\n"
	.db "6045\n"
	.db "1103\n"
	.db "3614\n"
	.db "6180\n"
	.db "8898\n"
	.db "1775\n"
	.db "\n"
	.db "3177\n"
	.db "5633\n"
	.db "2228\n"
	.db "3745\n"
	.db "1418\n"
	.db "5908\n"
	.db "5257\n"
	.db "1145\n"
	.db "2975\n"
	.db "4887\n"
	.db "4950\n"
	.db "3936\n"
	.db "2556\n"
	.db "3659\n"
	.db "5236\n"
	.db "\n"
	.db "2034\n"
	.db "6929\n"
	.db "8174\n"
	.db "10306\n"
	.db "8178\n"
	.db "2452\n"
	.db "10055\n"
	.db "10123\n"
	.db "\n"
	.db "2581\n"
	.db "5182\n"
	.db "3548\n"
	.db "3783\n"
	.db "2933\n"
	.db "5747\n"
	.db "5932\n"
	.db "2296\n"
	.db "4418\n"
	.db "6076\n"
	.db "1532\n"
	.db "4055\n"
	.db "3802\n"
	.db "2080\n"
	.db "3476\n"
	.db "\n"
	.db "3467\n"
	.db "18594\n"
	.db "8059\n"
	.db "11553\n"
	.db "\n"
	.db "3109\n"
	.db "\n"
	.db "1978\n"
	.db "1921\n"
	.db "2031\n"
	.db "3589\n"
	.db "4463\n"
	.db "6735\n"
	.db "3305\n"
	.db "7795\n"
	.db "5659\n"
	.db "5990\n"
	.db "\n"
	.db "3344\n"
	.db "6281\n"
	.db "10312\n"
	.db "4107\n"
	.db "1507\n"
	.db "2358\n"
	.db "\n"
	.db "9048\n"
	.db "1620\n"
	.db "9125\n"
	.db "14678\n"
	.db "\n"
	.db "50634\n"
	.db "\n"
	.db "10561\n"
	.db "\n"
	.db "4145\n"
	.db "1105\n"
	.db "5400\n"
	.db "3889\n"
	.db "5475\n"
	.db "4716\n"
	.db "3577\n"
	.db "2445\n"
	.db "2775\n"
	.db "6190\n"
	.db "3839\n"
	.db "1909\n"
	.db "2971\n"
	.db "\n"
	.db "3239\n"
	.db "3157\n"
	.db "1457\n"
	.db "2411\n"
	.db "2437\n"
	.db "1383\n"
	.db "4673\n"
	.db "4692\n"
	.db "5324\n"
	.db "2086\n"
	.db "4390\n"
	.db "6159\n"
	.db "1901\n"
	.db "3446\n"
	.db "\n"
	.db "2139\n"
	.db "3226\n"
	.db "3313\n"
	.db "2041\n"
	.db "5980\n"
	.db "1880\n"
	.db "5717\n"
	.db "2596\n"
	.db "3221\n"
	.db "2366\n"
	.db "1878\n"
	.db "2706\n"
	.db "3439\n"
	.db "3657\n"
	.db "4891\n"
	.db "\n"
	.db "5871\n"
	.db "4063\n"
	.db "3575\n"
	.db "4158\n"
	.db "6690\n"
	.db "2276\n"
	.db "3013\n"
	.db "4190\n"
	.db "6737\n"
	.db "7188\n"
	.db "3900\n"
	.db "6369\n"
	.db "\n"
	.db "3554\n"
	.db "1762\n"
	.db "6451\n"
	.db "4430\n"
	.db "6042\n"
	.db "4443\n"
	.db "3249\n"
	.db "4430\n"
	.db "1693\n"
	.db "1379\n"
	.db "4927\n"
	.db "3209\n"
	.db "\n"
	.db "2244\n"
	.db "4654\n"
	.db "6231\n"
	.db "3907\n"
	.db "2329\n"
	.db "6999\n"
	.db "3963\n"
	.db "5830\n"
	.db "2714\n"
	.db "6924\n"
	.db "6928\n"
	.db "2620\n"
	.db "\n"
	.db "10463\n"
	.db "4092\n"
	.db "4551\n"
	.db "9847\n"
	.db "5709\n"
	.db "7949\n"
	.db "4759\n"
	.db "10519\n"
	.db "\n"
	.db "3485\n"
	.db "2738\n"
	.db "5282\n"
	.db "5662\n"
	.db "3048\n"
	.db "5871\n"
	.db "5223\n"
	.db "5294\n"
	.db "2208\n"
	.db "4959\n"
	.db "4648\n"
	.db "3344\n"
	.db "5938\n"
	.db "2695\n"
	.db "\n"
	.db "5668\n"
	.db "2447\n"
	.db "9093\n"
	.db "6948\n"
	.db "9235\n"
	.db "9037\n"
	.db "1295\n"
	.db "1117\n"
	.db "\n"
	.db "6304\n"
	.db "7714\n"
	.db "2764\n"
	.db "5092\n"
	.db "3646\n"
	.db "1528\n"
	.db "4235\n"
	.db "3410\n"
	.db "5870\n"
	.db "6712\n"
	.db "\n"
	.db "6243\n"
	.db "4167\n"
	.db "5546\n"
	.db "5677\n"
	.db "4051\n"
	.db "4126\n"
	.db "1518\n"
	.db "3038\n"
	.db "5074\n"
	.db "2996\n"
	.db "4713\n"
	.db "5615\n"
	.db "3713\n"
	.db "5353\n"
	.db "\n"
	.db "1705\n"
	.db "7258\n"
	.db "2081\n"
	.db "4789\n"
	.db "1086\n"
	.db "3383\n"
	.db "1063\n"
	.db "1272\n"
	.db "7377\n"
	.db "1083\n"
	.db "2340\n"
	.db "1857\n"
	.db "\n"
	.db "6148\n"
	.db "8793\n"
	.db "15899\n"
	.db "16615\n"
	.db "\n"
	.db "1016\n"
	.db "1652\n"
	.db "10136\n"
	.db "4173\n"
	.db "10159\n"
	.db "7453\n"
	.db "8870\n"
	.db "7846\n"
	.db "\n"
	.db "3170\n"
	.db "6604\n"
	.db "4405\n"
	.db "7236\n"
	.db "5404\n"
	.db "3844\n"
	.db "4443\n"
	.db "6335\n"
	.db "5523\n"
	.db "7522\n"
	.db "4969\n"
	.db "\n"
	.db "3700\n"
	.db "5325\n"
	.db "2257\n"
	.db "5105\n"
	.db "4279\n"
	.db "3467\n"
	.db "5370\n"
	.db "2312\n"
	.db "4560\n"
	.db "5890\n"
	.db "2856\n"
	.db "5023\n"
	.db "2711\n"
	.db "6053\n"
	.db "1527\n"
	.db "\n"
	.db "6966\n"
	.db "6543\n"
	.db "2763\n"
	.db "3654\n"
	.db "6555\n"
	.db "4079\n"
	.db "3391\n"
	.db "1850\n"
	.db "5381\n"
	.db "1137\n"
	.db "7077\n"
	.db "1526\n"
	.db "\n"
	.db "43329\n"
	.db "\n"
	.db "5367\n"
	.db "3412\n"
	.db "3096\n"
	.db "3796\n"
	.db "2692\n"
	.db "5915\n"
	.db "5300\n"
	.db "1995\n"
	.db "2768\n"
	.db "6016\n"
	.db "3345\n"
	.db "5212\n"
	.db "3014\n"
	.db "1795\n"
	.db "5710\n"
	.db "\n"
	.db "1287\n"
	.db "3572\n"
	.db "3548\n"
	.db "3941\n"
	.db "6918\n"
	.db "1907\n"
	.db "4922\n"
	.db "6715\n"
	.db "5074\n"
	.db "6559\n"
	.db "6356\n"
	.db "1331\n"
	.db "4828\n"
	.db "\n"
	.db "1361\n"
	.db "3299\n"
	.db "4490\n"
	.db "6031\n"
	.db "2418\n"
	.db "2283\n"
	.db "6857\n"
	.db "4058\n"
	.db "6626\n"
	.db "3136\n"
	.db "6850\n"
	.db "1425\n"
	.db "3941\n"
	.db "\n"
	.db "53967\n"
	.db "\n"
	.db "58538\n"
	.db "\n"
	.db "7984\n"
	.db "2826\n"
	.db "7426\n"
	.db "3537\n"
	.db "2456\n"
	.db "7891\n"
	.db "\n"
	.db "25266\n"
	.db "\n"
	.db "4701\n"
	.db "14944\n"
	.db "3558\n"
	.db "9316\n"
	.db "10321\n"
	.db "\n"
	.db "4597\n"
	.db "4734\n"
	.db "7240\n"
	.db "4556\n"
	.db "1901\n"
	.db "2009\n"
	.db "6461\n"
	.db "2494\n"
	.db "3910\n"
	.db "2772\n"
	.db "3528\n"
	.db "5806\n"
	.db "\n"
	.db "1551\n"
	.db "10440\n"
	.db "4519\n"
	.db "4482\n"
	.db "7547\n"
	.db "3291\n"
	.db "1752\n"
	.db "7160\n"
	.db "\n"
	.db "6988\n"
	.db "2307\n"
	.db "7645\n"
	.db "2942\n"
	.db "2957\n"
	.db "8326\n"
	.db "5863\n"
	.db "8334\n"
	.db "5512\n"
	.db "6792\n"
	.db "\n"
	.db "9597\n"
	.db "12957\n"
	.db "2425\n"
	.db "9649\n"
	.db "3041\n"
	.db "\n"
	.db "8391\n"
	.db "5211\n"
	.db "6638\n"
	.db "3594\n"
	.db "7878\n"
	.db "6074\n"
	.db "5116\n"
	.db "2396\n"
	.db "\n"
	.db "1394\n"
	.db "8778\n"
	.db "8682\n"
	.db "5906\n"
	.db "4944\n"
	.db "4143\n"
	.db "1250\n"
	.db "7992\n"
	.db "7520\n"
	.db "7240\n"
	.db "\n"
	.db "1872\n"
	.db "8574\n"
	.db "9482\n"
	.db "7326\n"
	.db "10291\n"
	.db "3034\n"
	.db "2239\n"
	.db "4823\n"
	.db "\n"
	.db "4580\n"
	.db "6076\n"
	.db "2542\n"
	.db "4594\n"
	.db "2248\n"
	.db "2461\n"
	.db "2693\n"
	.db "3203\n"
	.db "6884\n"
	.db "4034\n"
	.db "6445\n"
	.db "\n"
	.db "6790\n"
	.db "8420\n"
	.db "2488\n"
	.db "6755\n"
	.db "15375\n"
	.db "\n"
	.db "5449\n"
	.db "2644\n"
	.db "2023\n"
	.db "8574\n"
	.db "10409\n"
	.db "4154\n"
	.db "10484\n"
	.db "9064\n"
	.db "\n"
	.db "9238\n"
	.db "5727\n"
	.db "6658\n"
	.db "6015\n"
	.db "1146\n"
	.db "5883\n"
	.db "\n"
	.db "16027\n"
	.db "11778\n"
	.db "4640\n"
	.db "15162\n"
	.db "4828\n"
	.db "\n"
	.db "3197\n"
	.db "7744\n"
	.db "1794\n"
	.db "5587\n"
	.db "4922\n"
	.db "3452\n"
	.db "\n"
	.db "2913\n"
	.db "29520\n"
	.db "\n"
	.db "6131\n"
	.db "3539\n"
	.db "2434\n"
	.db "6159\n"
	.db "1779\n"
	.db "2633\n"
	.db "1647\n"
	.db "6215\n"
	.db "1171\n"
	.db "1833\n"
	.db "6559\n"
	.db "\n"
	.db "4319\n"
	.db "9549\n"
	.db "2983\n"
	.db "1479\n"
	.db "3661\n"
	.db "6460\n"
	.db "9129\n"
	.db "7436\n"
	.db "\n"
	.db "3481\n"
	.db "21517\n"
	.db "2874\n"
	.db "\n"
	.db "6860\n"
	.db "6916\n"
	.db "7812\n"
	.db "1637\n"
	.db "5712\n"
	.db "8484\n"
	.db "7285\n"
	.db "3058\n"
	.db "2628\n"
	.db "2570\n"
	.db "\n"
	.db "1659\n"
	.db "3146\n"
	.db "1841\n"
	.db "5757\n"
	.db "3450\n"
	.db "1746\n"
	.db "1008\n"
	.db "5645\n"
	.db "1850\n"
	.db "6996\n"
	.db "1300\n"
	.db "1900\n"
	.db "\n"
	.db "2701\n"
	.db "9850\n"
	.db "2463\n"
	.db "6510\n"
	.db "16313\n"
	.db "\n"
	.db "7957\n"
	.db "9451\n"
	.db "13258\n"
	.db "5356\n"
	.db "13211\n"
	.db "11193\n"
	.db "\n"
	.db "2334\n"
	.db "19295\n"
	.db "10196\n"
	.db "1819\n"
	.db "\n"
	.db "5791\n"
	.db "5682\n"
	.db "5106\n"
	.db "3888\n"
	.db "3749\n"
	.db "7422\n"
	.db "9829\n"
	.db "10153\n"
	.db "\n"
	.db "3769\n"
	.db "5615\n"
	.db "1416\n"
	.db "3701\n"
	.db "3686\n"
	.db "3348\n"
	.db "3161\n"
	.db "3176\n"
	.db "2473\n"
	.db "2517\n"
	.db "2736\n"
	.db "1782\n"
	.db "5781\n"
	.db "3103\n"
	.db "\n"
	.db "5582\n"
	.db "10766\n"
	.db "8454\n"
	.db "1262\n"
	.db "10836\n"
	.db "8468\n"
	.db "\n"
	.db "7489\n"
	.db "2256\n"
	.db "3382\n"
	.db "4322\n"
	.db "2129\n"
	.db "1781\n"
	.db "2384\n"
	.db "6900\n"
	.db "3331\n"
	.db "4913\n"
	.db "3546\n"
	.db "\n"
	.db "6154\n"
	.db "4587\n"
	.db "4720\n"
	.db "6739\n"
	.db "2343\n"
	.db "6147\n"
	.db "3297\n"
	.db "5561\n"
	.db "6439\n"
	.db "5630\n"
	.db "1130\n"
	.db "5046\n"
	.db "\n"
	.db "5767\n"
	.db "5422\n"
	.db "5927\n"
	.db "1029\n"
	.db "5227\n"
	.db "3286\n"
	.db "5217\n"
	.db "1993\n"
	.db "2879\n"
	.db "4557\n"
	.db "4175\n"
	.db "2828\n"
	.db "3793\n"
	.db "2557\n"
	.db "\n"
	.db "2892\n"
	.db "7300\n"
	.db "3365\n"
	.db "3756\n"
	.db "7648\n"
	.db "2537\n"
	.db "4011\n"
	.db "7480\n"
	.db "6709\n"
	.db "4010\n"
	.db "1344\n"
	.db "\n"
	.db "6729\n"
	.db "1596\n"
	.db "2230\n"
	.db "7942\n"
	.db "10493\n"
	.db "3295\n"
	.db "10888\n"
	.db "\n"
	.db "3992\n"
	.db "3165\n"
	.db "7898\n"
	.db "3801\n"
	.db "3385\n"
	.db "4875\n"
	.db "2519\n"
	.db "4350\n"
	.db "2260\n"
	.db "3989\n"
	.db "5977\n"
	.db "\n"
	.db "3755\n"
	.db "7303\n"
	.db "1874\n"
	.db "3718\n"
	.db "5448\n"
	.db "2208\n"
	.db "3884\n"
	.db "7157\n"
	.db "4885\n"
	.db "\n"
	.db "5042\n"
	.db "5099\n"
	.db "2005\n"
	.db "3179\n"
	.db "3429\n"
	.db "4146\n"
	.db "2125\n"
	.db "4488\n"
	.db "6368\n"
	.db "3732\n"
	.db "2031\n"
	.db "6317\n"
	.db "5670\n"
	.db "4167\n"
	.db "\n"
	.db "4032\n"
	.db "7665\n"
	.db "1611\n"
	.db "1561\n"
	.db "8937\n"
	.db "4986\n"
	.db "2676\n"
	.db "7514\n"
	.db "3211\n"
	.db "\n"
	.db "5627\n"
	.db "3639\n"
	.db "1219\n"
	.db "4932\n"
	.db "3339\n"
	.db "4567\n"
	.db "2280\n"
	.db "1420\n"
	.db "1215\n"
	.db "4449\n"
	.db "3371\n"
	.db "1656\n"
	.db "5555\n"
	.db "3381\n"
	.db "2957\n"
	.db "\n"
	.db "5513\n"
	.db "11756\n"
	.db "4472\n"
	.db "4661\n"
	.db "11770\n"
	.db "2478\n"
	.db "9185\n"
	.db "\n"
	.db "5443\n"
	.db "6055\n"
	.db "4317\n"
	.db "2557\n"
	.db "2921\n"
	.db "3833\n"
	.db "7765\n"
	.db "1688\n"
	.db "4767\n"
	.db "7302\n"
	.db "\n"
	.db "11400\n"
	.db "7038\n"
	.db "11848\n"
	.db "5810\n"
	.db "4024\n"
	.db "8708\n"
	.db "9815\n"
	.db "\n"
	.db "5844\n"
	.db "8109\n"
	.db "9288\n"
	.db "5487\n"
	.db "4463\n"
	.db "4964\n"
	.db "8004\n"
	.db "3623\n"
	.db "5724\n"
	.db "\n"
	.db "55875\n"
	.db "\n"
	.db "7214\n"
	.db "6283\n"
	.db "6962\n"
	.db "4385\n"
	.db "8165\n"
	.db "9330\n"
	.db "4506\n"
	.db "6456\n"
	.db "3249\n"
	.db "\n"
	.db "24141\n"
	.db "17839\n"
	.db "\n"
	.db "2814\n"
	.db "3522\n"
	.db "3834\n"
	.db "5491\n"
	.db "1959\n"
	.db "1653\n"
	.db "4548\n"
	.db "3150\n"
	.db "1922\n"
	.db "4649\n"
	.db "\n"
	.db "6544\n"
	.db "5722\n"
	.db "6447\n"
	.db "8079\n"
	.db "2292\n"
	.db "1218\n"
	.db "1530\n"
	.db "6004\n"
	.db "6519\n"
	.db "8616\n"
	.db "\n"
	.db "4716\n"
	.db "5361\n"
	.db "3212\n"
	.db "1483\n"
	.db "6032\n"
	.db "1168\n"
	.db "4369\n"
	.db "2808\n"
	.db "5251\n"
	.db "5770\n"
	.db "3025\n"
	.db "6059\n"
	.db "3971\n"
	.db "5611\n"
	.db "\n"
	.db "6900\n"
	.db "6349\n"
	.db "6359\n"
	.db "3559\n"
	.db "6089\n"
	.db "2025\n"
	.db "5909\n"
	.db "2623\n"
	.db "4366\n"
	.db "3829\n"
	.db "2205\n"
	.db "6696\n"
	.db "\n"
	.db "3958\n"
	.db "6196\n"
	.db "2973\n"
	.db "3056\n"
	.db "2921\n"
	.db "4351\n"
	.db "3940\n"
	.db "2188\n"
	.db "4689\n"
	.db "3217\n"
	.db "1877\n"
	.db "4609\n"
	.db "6174\n"
	.db "1043\n"
	.db "\n"
	.db "8572\n"
	.db "10692\n"
	.db "4142\n"
	.db "3022\n"
	.db "3764\n"
	.db "10663\n"
	.db "1347\n"
	.db "6173\n"
	.db "\n"
	.db "1618\n"
	.db "9886\n"
	.db "7620\n"
	.db "9968\n"
	.db "1839\n"
	.db "3526\n"
	.db "3621\n"
	.db "8521\n"
	.db "\n"
	.db "8813\n"
	.db "11132\n"
	.db "15555\n"
	.db "5470\n"
	.db "1312\n"
	.db "\n"
	.db "4025\n"
	.db "7513\n"
	.db "2082\n"
	.db "2426\n"
	.db "3542\n"
	.db "7940\n"
	.db "4392\n"
	.db "2387\n"
	.db "2528\n"
	.db "1031\n"
	.db "\n"
	.db "4693\n"
	.db "12069\n"
	.db "2956\n"
	.db "3424\n"
	.db "9052\n"
	.db "10365\n"
	.db "7715\n"
	.db "\n"
	.db "6014\n"
	.db "4190\n"
	.db "1926\n"
	.db "1571\n"
	.db "4337\n"
	.db "3544\n"
	.db "5594\n"
	.db "4324\n"
	.db "2836\n"
	.db "2075\n"
	.db "1644\n"
	.db "3130\n"
	.db "4123\n"
	.db "2728\n"
	.db "\n"
	.db "5682\n"
	.db "11910\n"
	.db "3177\n"
	.db "6967\n"
	.db "10603\n"
	.db "5430\n"
	.db "\n"
	.db "2105\n"
	.db "10866\n"
	.db "6804\n"
	.db "6925\n"
	.db "7798\n"
	.db "10432\n"
	.db "8296\n"
	.db "\n"
	.db "5642\n"
	.db "8469\n"
	.db "5896\n"
	.db "5141\n"
	.db "6586\n"
	.db "5742\n"
	.db "9623\n"
	.db "8271\n"
	.db "\n"
	.db "21333\n"
	.db "13036\n"
	.db "\n"
	.db "11736\n"
	.db "9354\n"
	.db "6388\n"
	.db "9104\n"
	.db "7534\n"
	.db "11007\n"
	.db "9054\n"
	.db "\n"
	.db "5503\n"
	.db "8509\n"
	.db "3348\n"
	.db "1887\n"
	.db "9859\n"
	.db "7303\n"
	.db "10324\n"
	.db "\n"
	.db "10723\n"
	.db "3345\n"
	.db "4989\n"
	.db "10727\n"
	.db "9831\n"
	.db "\n"
	.db "6278\n"
	.db "2447\n"
	.db "7489\n"
	.db "2763\n"
	.db "6210\n"
	.db "5940\n"
	.db "1997\n"
	.db "7499\n"
	.db "1136\n"
	.db "2913\n"
	.db "5045\n"
	.db "\n"
	.db "11549\n"
	.db "15174\n"
	.db "\n"
	.db "6691\n"
	.db "2272\n"
	.db "7002\n"
	.db "3091\n"
	.db "3492\n"
	.db "2790\n"
	.db "5359\n"
	.db "5071\n"
	.db "1177\n"
	.db "3777\n"
	.db "4431\n"
	.db "3524\n"
	.db "\n"
	.db "16104\n"
	.db "7757\n"
	.db "15578\n"
	.db "\n"
	.db "8940\n"
	.db "1139\n"
	.db "9935\n"
	.db "10083\n"
	.db "3451\n"
	.db "7287\n"
	.db "6594\n"
	.db "3007\n"
	.db "\n"
	.db "1491\n"
	.db "2604\n"
	.db "3108\n"
	.db "4882\n"
	.db "5901\n"
	.db "3393\n"
	.db "1665\n"
	.db "7819\n"
	.db "7221\n"
	.db "1593\n"
	.db "4645\n"
	.db "\n"
	.db "1365\n"
	.db "11628\n"
	.db "8502\n"
	.db "9468\n"
	.db "8638\n"
	.db "8219\n"
	.db "8880\n"
	.db "\n"
	.db "2937\n"
	.db "13922\n"
	.db "2323\n"
	.db "5126\n"
	.db "3722\n"
	.db "6835\n"
	.db "\n"
	.db "1108\n"
	.db "1336\n"
	.db "5054\n"
	.db "9811\n"
	.db "3846\n"
	.db "2925\n"
	.db "1268\n"
	.db "\n"
	.db "4398\n"
	.db "6669\n"
	.db "8740\n"
	.db "10287\n"
	.db "4969\n"
	.db "\n"
	.db "13246\n"
	.db "\n"
	.db "6402\n"
	.db "8076\n"
	.db "1010\n"
	.db "4392\n"
	.db "2101\n"
	.db "4365\n"
	.db "2139\n"
	.db "7963\n"
	.db "6078\n"
	.db "\n"
	.db "1122\n"
	.db "4123\n"
	.db "13473\n"
	.db "4701\n"
	.db "14157\n"
	.db "\n"
	.db "17539\n"
	.db "15944\n"
	.db "17893\n"
	.db "8376\n"
	.db "\n"
	.db "68056\n"
	.db "\n"
	.db "5208\n"
	.db "4934\n"
	.db "5001\n"
	.db "5758\n"
	.db "1447\n"
	.db "2272\n"
	.db "3586\n"
	.db "3761\n"
	.db "2012\n"
	.db "2663\n"
	.db "5023\n"
	.db "4671\n"
	.db "1296\n"
	.db "6055\n"
	.db "5198\n"
	.db "\n"
	.db "1295\n"
	.db "4069\n"
	.db "2210\n"
	.db "5072\n"
	.db "3547\n"
	.db "4437\n"
	.db "5520\n"
	.db "5498\n"
	.db "4907\n"
	.db "5945\n"
	.db "4221\n"
	.db "1405\n"
	.db "4506\n"
	.db "2862\n"
	.db "4030\n"
	.db "\n"
	.db "8962\n"
	.db "2658\n"
	.db "5362\n"
	.db "4213\n"
	.db "7268\n"
	.db "2284\n"
	.db "\n"
	.db "5226\n"
	.db "8628\n"
	.db "10535\n"
	.db "5284\n"
	.db "12189\n"
	.db "6523\n"
	.db "\n"
	.db "8336\n"
	.db "8105\n"
	.db "5094\n"
	.db "6885\n"
	.db "7406\n"
	.db "7252\n"
	.db "9332\n"
	.db "9597\n"
	.db "4504\n"
	.db "\n"
	.db "2108\n"
	.db "3800\n"
	.db "5986\n"
	.db "1793\n"
	.db "4395\n"
	.db "5762\n"
	.db "4297\n"
	.db "1900\n"
	.db "6256\n"
	.db "1205\n"
	.db "3552\n"
	.db "4270\n"
	.db "2859\n"
	.db "2140\n"
	.db "\n"
	.db "2161\n"
	.db "8356\n"
	.db "7062\n"
	.db "6218\n"
	.db "7964\n"
	.db "7875\n"
	.db "3891\n"
	.db "4178\n"
	.db "7126\n"
	.db "2369\n"
	.db "\n"
	.db "2077\n"
	.db "6348\n"
	.db "2757\n"
	.db "5734\n"
	.db "1632\n"
	.db "6196\n"
	.db "3700\n"
	.db "5385\n"
	.db "2898\n"
	.db "2310\n"
	.db "5376\n"
	.db "4158\n"
	.db "2413\n"
	.db "\n"
	.db "8368\n"
	.db "3632\n"
	.db "8981\n"
	.db "10269\n"
	.db "5839\n"
	.db "2386\n"
	.db "5302\n"
	.db "\n"
	.db "2194\n"
	.db "13530\n"
	.db "6742\n"
	.db "2611\n"
	.db "\n"
	.db "7395\n"
	.db "7424\n"
	.db "3719\n"
	.db "6504\n"
	.db "8396\n"
	.db "4896\n"
	.db "6918\n"
	.db "8754\n"
	.db "3316\n"
	.db "\n"
	.db "2712\n"
	.db "4870\n"
	.db "5014\n"
	.db "2195\n"
	.db "4629\n"
	.db "2415\n"
	.db "6338\n"
	.db "5244\n"
	.db "6682\n"
	.db "5050\n"
	.db "1141\n"
	.db "3762\n"
	.db "6459\n"
	.db "\n"
	.db "17272\n"
	.db "18789\n"
	.db "6571\n"
	.db "\n"
	.db "3488\n"
	.db "2091\n"
	.db "3800\n"
	.db "3821\n"
	.db "4206\n"
	.db "5993\n"
	.db "6173\n"
	.db "5600\n"
	.db "1670\n"
	.db "4492\n"
	.db "4136\n"
	.db "5512\n"
	.db "3093\n"
	.db "\n"
	.db "1954\n"
	.db "5637\n"
	.db "1637\n"
	.db "5661\n"
	.db "1053\n"
	.db "1728\n"
	.db "3798\n"
	.db "7454\n"
	.db "5787\n"
	.db "6616\n"
	.db "5415\n"
	.db "5393\n"
	.db "\n"
	.db "2181\n"
	.db "4290\n"
	.db "5407\n"
	.db "3608\n"
	.db "1568\n"
	.db "6300\n"
	.db "1619\n"
	.db "1006\n"
	.db "4916\n"
	.db "6100\n"
	.db "5025\n"
	.db "2718\n"
	.db "4054\n"
	.db "2302\n"
	.db "\n"
	.db "5513\n"
	.db "6726\n"
	.db "2804\n"
	.db "2655\n"
	.db "6385\n"
	.db "4049\n"
	.db "2492\n"
	.db "4405\n"
	.db "2569\n"
	.db "6428\n"
	.db "3742\n"
	.db "5037\n"
	.db "6014\n"
	.db "\n"
	.db "3531\n"
	.db "4133\n"
	.db "1549\n"
	.db "9146\n"
	.db "8227\n"
	.db "5186\n"
	.db "5159\n"
	.db "1952\n"